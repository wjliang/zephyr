## boards/arm/xlnx_ultra96/Kconfig.board
```kconfig
# Kconfig - Xilinx Ultra96 board configuration
#
# Copyright (c) 2018 Xilinx Inc.
#
# SPDX-License-Identifier: Apache-2.0

config BOARD_XLNX_ULTRA96_R5
	bool "Xilinx Ultra96 R5"
```

## boards/arm/xlnx_ultra96/Kconfig.defconfig
```kconfig
# Kconfig - 96Boards Carbon nRF51 board default configuration
#
# Copyright (c) 2016, 2017 Linaro Limited.
#
# SPDX-License-Identifier: Apache-2.0

if BOARD_XLNX_ULTRA96_R5

config BOARD
	default "xlnx_ultra96_r5"

config SOC_FAMILY_CPU
	default "cortex_r5"

endif # BOARD_XLNX_ULTRA96_R5
```

## boards/arm/xlnx_ultra96/xlnx_ultra96_r5_defconfig
```kconfig
CONFIG_ARM=y
CONFIG_BOARD_XLNX_ULTRA96_R5=y
CONFIG_SOC_FAMILY_ZYNQMP=y
CONFIG_SOC_XLNX_ZYNQMP_R5=y
CONFIG_SYS_CLOCK_HW_CYCLES_PER_SEC=499999512
CONFIG_SERIAL=y
CONFIG_CONSOLE=y
CONFIG_UART_CONSOLE=y
```

## drivers/serial/Kconfig.xlnx
```kconfig
# Kconfig - Xilinx UART configuration
#
# Copyright (c) 2018 Xilinx Inc.
#
# SPDX-License-Identifier: Apache-2.0
#

menuconfig UART_XLNX_PS
	bool "Xilinx serial driver for MPSoC"
	depends on SOC_FAMILY_ZYNQMP
	select SERIAL_HAS_DRIVER
	help
	  This option enables the UART driver for Xilinx MPSoC
          platforms.
	  Say y if you wish to use serial port on Xilinx MPSoC
          platforms.
```

## dts/bindings/arm/cpu.yaml
```yaml
#
# Copyright (c) 2018 Marvell
#
# SPDX-License-Identifier: Apache-2.0
#
---
title: CPU
version: 0.1

description: >
    This binding describes CPU

properties:
    compatible:
      category: required
      type: string
      description: compatible strings
      constraint: "arm,cortex-r5"
      generation: define

    reg:
      category: required
      type: int
      description: mmio register space
      generation: define

    label:
      category: required
      type: string
      description: Human readable string describing the device (used by Zephyr for API name)
      generation: define

cell_string: IRQ

"#cells":
  - cpu_id
  - priority
  - flags
...
```

## dts/bindings/interrupt-controller/xlnx,scugic.yaml
```yaml
#
# Copyright (c) 2018 Marvell
#
# SPDX-License-Identifier: Apache-2.0
#
---
title: PL390 Interrupt Controller on Xilinx SoC
version: 0.1

description: >
    This binding describes the PL390 Interrupt Controller on Xilinx SoC.

properties:
    compatible:
      category: required
      type: string
      description: compatible strings
      constraint: "xlnx,scugic"
      generation: define

    reg:
      category: required
      type: int
      description: mmio register space
      generation: define

    label:
      category: required
      type: string
      description: Human readable string describing the device (used by Zephyr for API name)
      generation: define

cell_string: IRQ

"#cells":
  - irq
  - priority
  - flags
...
```

## dts/bindings/serial/xlnx,uartps.yaml
```yaml
---
title: Xilinx PS UART
version: 0.1

description: >
    This binding gives a base representation of the Xilinx PS UART

inherits:
    !include uart.yaml

properties:
    compatible:
      constraint: "xlnx,xuartps"

    reg:
      type: array
      description: mmio register space
      generation: define
      category: required

    interrupts:
      type: array
      category: optional
      description: required interrupts
      generation: define
...
```

## dts/bindings/timer/xlnx,ttcps.yaml
```yaml
---
title: Xilinx ZynqMP PS TTC TIMERS
version: 0.1

description: >
    This binding gives a base representation of the Xilinx ZynqMP PS TTC TIMERS

properties:
    compatible:
      type: string
      category: required
      description: compatible strings
      constraint: "cdns,ttc"
      generation: define

    label:
      type: string
      category: required
      description: Human readable string describing the device (used by Zephyr for API name)
      generation: define

    reg:
      type: array
      description: mmio register space
      generation: define
      category: required

    clock-frequency:
      type: int
      category: optional
      description: Clock frequency information for Timer operation
      generation: define

    interrupts:
      type: array
      category: optional
      description: required interrupts
      generation: define
...
```

## soc/arm/xlnx_zynqmp/Kconfig
```kconfig
# Kconfig - Xilinx ZynqMP platform configuration options

#
# Copyright (c) 2018 Xilinx, Inc.
#
# SPDX-License-Identifier: Apache-2.0
#

config SOC_FAMILY_ZYNQMP
	bool "Xilinx ZynqMP family"

if SOC_FAMILY_ZYNQMP
config SOC_FAMILY
	string
	default "xlnx_zynqmp"

config SOC_FAMILY_CPU
	string "Xilinx ZynqMP CPU Type"
endif
```

## soc/arm/xlnx_zynqmp/Kconfig.defconfig
```kconfig
# Kconfig - TI LM3S6965 platform configuration options

#
# Copyright (c) 2014-2015 Wind River Systems, Inc.
#
# SPDX-License-Identifier: Apache-2.0
#

if SOC_FAMILY_ZYNQMP

config SOC
	default "xlnx_zynqmp"

endif # SOC_FAMILY_ZYNQMP

source "soc/arm/xlnx_zynqmp/*/Kconfig.defconfig.soc"
```

## soc/arm/xlnx_zynqmp/cortex_r5/Kconfig.defconfig.soc
```kconfig
# Kconfig - ST Microelectronics STM32F2 MCU line
#
# Copyright (c) 2018 qianfan Zhao <qianfanguijin@163.com>
#
# SPDX-License-Identifier: Apache-2.0
#

if SOC_XLNX_ZYNQMP_R5
config NUM_IRQS
	int
	# must be >= the highest interrupt number used
	# - include the UART interrupts
	default 195

config MULTI_LEVEL_INTERRUPTS
	default y

config 2ND_LEVEL_INTERRUPTS
	default y

config NUM_2ND_LEVEL_AGGREGATORS
	default 1

config MAX_IRQ_PER_AGGREGATOR
	default 255

config 2ND_LVL_INTR_00_OFFSET
	default 0

if SERIAL
config UART_XLNX_PS
	default y

endif # SERIAL

config XLNX_PSTTC_TIMER
	default y

config XLNX_SCUGIC
	default y

endif # SOC_XLNX_ZYNQMP_R5
```

## soc/arm/xlnx_zynqmp/cortex_r5/Kconfig.soc
```kconfig
# Kconfig - ST Microelectronics STM32F2X MCU series
#
# Copyright (c) 2018 qianfan Zhao <qianfanguijin@163.com>
#
# SPDX-License-Identifier: Apache-2.0
#

config SOC_XLNX_ZYNQMP_R5
	bool "Xilinx ZynqMP family RPU"
	select CPU_CORTEX_R5
	help
	  Enable support for Xilinx ZynqMP R5
```
